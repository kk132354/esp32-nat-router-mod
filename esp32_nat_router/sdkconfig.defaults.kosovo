## wg-tunnel/germany_gateway_esp32/main/Kconfig.projbuild
```kconfig
menu "Deutschland-Gateway (ESP32 DevKit)"

    config STA_SSID
        string "WLAN-Name (Router in Deutschland)"
        default "myssid"

    config STA_PASSWORD
        string "WLAN-Passwort (Router)"
        default ""

    config AP_SSID
        string "Eigenes WLAN fuer deine Geraete (SoftAP)"
        default "KosovoVPN"

    config AP_PASSWORD
        string "Passwort des SoftAP (mind. 8 Zeichen, leer = offen)"
        default ""

    config AP_IP
        string "IP des SoftAP (darf nicht im Netz des Routers liegen)"
        default "192.168.50.1"

    config AP_MAX_CLIENTS
        int "Max. Clients am SoftAP"
        default 4

    config DNS_SERVER
        string "DNS-Server, der an Clients verteilt wird (laeuft durch den Tunnel)"
        default "1.1.1.1"

    config NTP_SERVER
        string "NTP-Server"
        default "pool.ntp.org"

    config WG_PRIVATE_KEY
        string "Privater Schluessel dieses Geraets (base64)"
        default ""

    config WG_PEER_PUBLIC_KEY
        string "Oeffentlicher Schluessel des Kosovo-C3 (base64)"
        default ""

    config WG_PRESHARED_KEY
        string "Optionaler Preshared Key (base64, leer = keiner)"
        default ""

    config WG_PEER_PLACEHOLDER
        string "Platzhalter-Endpoint des C3 (wird nach dem ersten Handshake ueberschrieben)"
        default "192.0.2.1"

    config WG_LISTEN_PORT
        int "UDP-Port, auf dem der C3 dieses Gateway erreicht (Portweiterleitung!)"
        default 51820

    config WG_LOCAL_IP
        string "Tunnel-IP dieses Geraets"
        default "10.8.0.2"

    config WG_LOCAL_NETMASK
        string "Tunnel-Netzmaske"
        default "255.255.255.0"

endmenu

menu "Luefter (temperaturgesteuert)"

    config FAN_GPIO
        int "GPIO, der das Relais/den Transistor schaltet"
        default 4 if IDF_TARGET_ESP32C3
        default 26

    config FAN_ACTIVE_LOW
        bool "Ausgang schaltet bei LOW (nur fuer Relaismodule mit Low-Trigger; Transistor: aus)"
        default n

    config FAN_ON_TEMP_C
        int "Luefter AN ab (Grad C)"
        default 52

    config FAN_OFF_TEMP_C
        int "Luefter AUS bei (Grad C)"
        default 42

    config FAN_CHECK_S
        int "Messintervall in Sekunden"
        default 5

    config FAN_MIN_HOLD_S
        int "Mindestzeit zwischen zwei Schaltvorgaengen (s)"
        default 30


endmenu

menu "Webseite (Anmeldung, Gegenstelle)"

    config WEB_PEER_IP
        string "Tunnel-IP des ANDEREN Geraets (fuer /peer/)"
        default "10.8.0.1"

    config WEB_TRUST_AP
        bool "Geraete im eigenen SoftAP-WLAN sind vertraut (nur DevKit)"
        default y

    config WEB_TRUST_LAN
        bool "Geraete im Heimnetz (Router-WLAN) sind vertraut"
        default y

    config WEB_RESET_GPIO
        int "Taste, die 5 s gehalten das Passwort loescht (BOOT-Taste)"
        default 9 if IDF_TARGET_ESP32C3
        default 0

endmenu

menu "Firmware-Update (OTA)"

    config OTA_VERIFY_S
        int "Sekunden, bis eine neue Firmware den Tunnel haben muss (sonst Rollback)"
        default 300
        range 60 1800

endmenu
```

## wg-tunnel/germany_gateway_esp32/sdkconfig.defaults
```kconfig
# Routing + NAT (Clients am SoftAP -> WireGuard-Tunnel)
CONFIG_LWIP_IP_FORWARD=y
CONFIG_LWIP_IPV4_NAPT=y
CONFIG_LWIP_IP4_FRAG=y
CONFIG_LWIP_IP4_REASSEMBLY=y

# WireGuard (x25519) braucht grosse Stacks
CONFIG_LWIP_TCPIP_TASK_STACK_SIZE=8192
CONFIG_ESP_MAIN_TASK_STACK_SIZE=8192

# Etwas mehr Durchsatz
CONFIG_LWIP_TCPIP_RECVMBOX_SIZE=64
CONFIG_ESP_WIFI_DYNAMIC_RX_BUFFER_NUM=32

CONFIG_STA_SSID="krasniqi"
CONFIG_STA_PASSWORD="94503796453838356384"
CONFIG_AP_SSID="KosovoVPN"
CONFIG_AP_PASSWORD="192837465"
CONFIG_WG_PRIVATE_KEY="zwN99WTIMGOJVLX6Mswa6w8GhRw5l2UEKrU8Zxl95NI="
CONFIG_WG_PEER_PUBLIC_KEY="VBJIQApE/iaUYQ4twgBi35tQhFjC7bxRrGCckz8rqgA="
```

## wg-tunnel/kosovo_exit_c3/main/Kconfig.projbuild
```kconfig
menu "Kosovo Exit-Node (ESP32-C3)"

    config WIFI_SSID
        string "WLAN-Name (Router im Kosovo)"
        default "myssid"

    config WIFI_PASSWORD
        string "WLAN-Passwort"
        default ""

    config NTP_SERVER
        string "NTP-Server (WireGuard braucht korrekte Uhrzeit)"
        default "pool.ntp.org"

    config WG_PRIVATE_KEY
        string "Privater Schluessel dieses Geraets (base64)"
        default ""

    config WG_PEER_PUBLIC_KEY
        string "Oeffentlicher Schluessel des Deutschland-Gateways (base64)"
        default ""

    config WG_PRESHARED_KEY
        string "Optionaler Preshared Key (base64, leer = keiner)"
        default ""

    config WG_PEER_ENDPOINT
        string "DDNS-Name oder IP des Deutschland-Gateways"
        default "meinname.duckdns.org"

    config WG_PEER_PORT
        int "UDP-Port des Gateways (Portweiterleitung im deutschen Router)"
        default 51820

    config WG_LOCAL_PORT
        int "Lokaler UDP-Port"
        default 51820

    config WG_LOCAL_IP
        string "Tunnel-IP dieses Geraets"
        default "10.8.0.1"

    config WG_LOCAL_NETMASK
        string "Tunnel-Netzmaske"
        default "255.255.255.0"

    config WG_KEEPALIVE
        int "Persistent Keepalive in Sekunden (haelt NAT-Eintrag offen)"
        default 25

    config TUNNEL_DOWN_RESTART_S
        int "Neustart, wenn Tunnel so lange (s) nicht steht"
        default 180

endmenu

menu "Luefter (temperaturgesteuert)"

    config FAN_GPIO
        int "GPIO, der das Relais/den Transistor schaltet"
        default 4 if IDF_TARGET_ESP32C3
        default 26

    config FAN_ACTIVE_LOW
        bool "Ausgang schaltet bei LOW (nur fuer Relaismodule mit Low-Trigger; Transistor: aus)"
        default n

    config FAN_ON_TEMP_C
        int "Luefter AN ab (Grad C)"
        default 52

    config FAN_OFF_TEMP_C
        int "Luefter AUS bei (Grad C)"
        default 42

    config FAN_CHECK_S
        int "Messintervall in Sekunden"
        default 5

    config FAN_MIN_HOLD_S
        int "Mindestzeit zwischen zwei Schaltvorgaengen (s)"
        default 30


endmenu

menu "Webseite (Anmeldung, Gegenstelle)"

    config WEB_PEER_IP
        string "Tunnel-IP des ANDEREN Geraets (fuer /peer/)"
        default "10.8.0.2"

    config WEB_TRUST_AP
        bool "Geraete im eigenen SoftAP-WLAN sind vertraut (nur DevKit)"
        default n

    config WEB_TRUST_LAN
        bool "Geraete im Heimnetz (Router-WLAN) sind vertraut"
        default n

    config WEB_RESET_GPIO
        int "Taste, die 5 s gehalten das Passwort loescht (BOOT-Taste)"
        default 9 if IDF_TARGET_ESP32C3
        default 0

endmenu

menu "Firmware-Update (OTA)"

    config OTA_VERIFY_S
        int "Sekunden, bis eine neue Firmware den Tunnel haben muss (sonst Rollback)"
        default 300
        range 60 1800

endmenu
```

## wg-tunnel/kosovo_exit_c3/sdkconfig.defaults
```kconfig
# Routing + NAT (der C3 ist der Ausgang ins Internet)
CONFIG_LWIP_IP_FORWARD=y
CONFIG_LWIP_IPV4_NAPT=y
CONFIG_LWIP_IP4_FRAG=y
CONFIG_LWIP_IP4_REASSEMBLY=y

# WireGuard (x25519) braucht grosse Stacks
CONFIG_LWIP_TCPIP_TASK_STACK_SIZE=8192
CONFIG_ESP_MAIN_TASK_STACK_SIZE=8192

# Etwas mehr Durchsatz
CONFIG_LWIP_TCPIP_RECVMBOX_SIZE=64
CONFIG_ESP_WIFI_DYNAMIC_RX_BUFFER_NUM=32

CONFIG_WIFI_SSID="Redmi"
CONFIG_WIFI_PASSWORD="hahalustignicht"
CONFIG_WG_PRIVATE_KEY="TKOmtD6Pvf47ZgY89yYGo8Uw1IRMzPiP5QCgk9BV/gc="
CONFIG_WG_PEER_PUBLIC_KEY="weIiw56xqh3zXIUdaDfxepbiFYhEjTxH2WZ5ybLGpw4="
CONFIG_WG_PEER_ENDPOINT="kk132.duckdns.org"

CONFIG_LWIP_PPP_SUPPORT=y
```
